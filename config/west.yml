## config/west.yml
```yaml
manifest:
  remotes:
    - name: zmkfirmware
      url-base: https://github.com/zmkfirmware
    - name: mctechnology17
      url-base: https://github.com/mctechnology17
    - name: myzmk
      url-base: https://github.com/bradinglis
    - name: urob
      url-base: https://github.com/urob
  projects:
    - name: zmk
      remote: myzmk
      revision: main
      import: app/west.yml
    - name: zmk-unicode
      remote: urob
      revision: v0.3
    - name: zmk-nice-oled
      remote: mctechnology17
      revision: main
  self:
    path: config
```
